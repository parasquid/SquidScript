## CMakeLists.txt
```
cmake_minimum_required(VERSION 3.20.0)

find_package(Zephyr REQUIRED HINTS $ENV{ZEPHYR_BASE})
project(squidscript_ble_ots_init_tests)

include(../../cmake/squidvm_ffi.cmake)

set(SQUID_ZEPHYR_TARGET_JSON "$ENV{SQUID_ZEPHYR_TARGET_JSON}" CACHE FILEPATH "SquidScript target metadata JSON")
if(SQUID_ZEPHYR_TARGET_JSON STREQUAL "")
  set(SQUID_ZEPHYR_TARGET_JSON "${CMAKE_CURRENT_LIST_DIR}/../../../../targets/esp32c3-super-mini.target.json")
endif()
set(SQUID_ZEPHYR_TARGET_OVERLAY "$ENV{SQUID_ZEPHYR_TARGET_OVERLAY}" CACHE FILEPATH "SquidScript Zephyr target overlay")
if(SQUID_ZEPHYR_TARGET_OVERLAY STREQUAL "")
  set(SQUID_ZEPHYR_TARGET_OVERLAY "${CMAKE_CURRENT_LIST_DIR}/../../boards/esp32c3_supermini.overlay")
endif()
set(SQUID_ZEPHYR_TARGET_DEFAULTS_H "${CMAKE_CURRENT_BINARY_DIR}/generated/squidscript_target_defaults.h")
execute_process(
  COMMAND "${Python3_EXECUTABLE}" "${CMAKE_CURRENT_LIST_DIR}/../../../../scripts/generate-zephyr-target-defaults.py" "${SQUID_ZEPHYR_TARGET_JSON}" "${SQUID_ZEPHYR_TARGET_DEFAULTS_H}" --zephyr-overlay "${SQUID_ZEPHYR_TARGET_OVERLAY}"
  RESULT_VARIABLE SQUID_ZEPHYR_TARGET_DEFAULTS_RESULT
)
if(NOT SQUID_ZEPHYR_TARGET_DEFAULTS_RESULT EQUAL 0)
  message(FATAL_ERROR "Failed to generate SquidScript Zephyr target defaults")
endif()

target_include_directories(app PRIVATE ../../src "${CMAKE_CURRENT_BINARY_DIR}/generated")
target_sources(app PRIVATE
  ../../src/ble_ots.c
  src/main.c
)

squidscript_link_squidvm_ffi(app)
```

## Kconfig
```
menu "SquidScript BLE OTS init test firmware"

config SQUIDSCRIPT_ZEPHYR_DIAGNOSTIC
	bool "Enable SquidScript diagnostic test paths"
	default y

config SQUIDSCRIPT_BLE_OTS_INIT_TEST
	bool "Compile the SquidScript BLE OTS skeleton into the test image"
	default y
	help
	  Expose the BLE OTS GATT service in the native_sim test image so
	  unit tests can verify that the service is registered and its
	  callbacks are wired without requiring real Bluetooth hardware.
	  The OTS callbacks are stubbed (LOG_DBG + return 0) at this
	  slice; later slices implement the actual staging and dispatch
	  logic.

endmenu

source "Kconfig.zephyr"
```

## prj.conf
```kconfig
CONFIG_ZTEST=y
CONFIG_INIT_STACKS=y
CONFIG_THREAD_STACK_INFO=y
CONFIG_BT=y
CONFIG_BT_PERIPHERAL=y
CONFIG_BT_OTS=y
CONFIG_BT_OTS_SECONDARY_SVC=y
CONFIG_BT_OTS_OACP_CREATE_SUPPORT=y
CONFIG_BT_OTS_OACP_WRITE_SUPPORT=y
CONFIG_BT_OTS_OBJ_NAME_WRITE_SUPPORT=y
```

## src/main.c
```c
#include <errno.h>
#include <stddef.h>
#include <stdint.h>
#include <string.h>

#include <zephyr/bluetooth/bluetooth.h>
#include <zephyr/bluetooth/services/ots.h>
#include <zephyr/kernel.h>
#include <zephyr/ztest.h>

#include "ble_ots.h"

ZTEST_SUITE(ble_ots_init, NULL, NULL, NULL, NULL, NULL);

ZTEST(ble_ots_init, test_ots_service_registers_via_init)
{
	int result = sq_ble_ots_init();

	zassert_equal(result, 0, "expected 0 from sq_ble_ots_init, got %d", result);
}

ZTEST(ble_ots_init, test_ots_service_decl_handle_is_non_null)
{
	int result = sq_ble_ots_init();

	zassert_equal(result, 0, "expected 0 from sq_ble_ots_init, got %d", result);
	zassert_not_null(sq_ble_ots_svc_decl_get(),
			 "expected non-NULL OTS service declaration handle");
}

ZTEST(ble_ots_init, test_init_is_idempotent)
{
	zassert_equal(sq_ble_ots_init(), 0);
	zassert_equal(sq_ble_ots_init(), 0, "second sq_ble_ots_init should be a no-op");
	zassert_not_null(sq_ble_ots_svc_decl_get());
}

ZTEST(ble_ots_init, test_obj_created_stub_rejects_when_no_profile_armed)
{
	int result;

	zassert_equal(sq_ble_ots_init(), 0);
	result = sq_ble_ots_test_invoke_obj_created(NULL, 0, NULL, NULL);
	zassert_true(result < 0, "expected negative error from obj_created stub, got %d",
		     result);
}

ZTEST(ble_ots_init, test_obj_write_stub_accepts)
{
	zassert_equal(sq_ble_ots_init(), 0);
	zassert_equal(sq_ble_ots_test_invoke_obj_write(NULL, 0, "data", 4, 0, 0), 4,
		      "obj_write stub should return len on success");
}
```
