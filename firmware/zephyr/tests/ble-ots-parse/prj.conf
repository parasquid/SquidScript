## CMakeLists.txt
```
cmake_minimum_required(VERSION 3.20.0)

find_package(Zephyr REQUIRED HINTS $ENV{ZEPHYR_BASE})
project(squidscript_ble_ots_parse_tests)

include(../../cmake/squidvm_ffi.cmake)

set(SQUID_ZEPHYR_TARGET_JSON "$ENV{SQUID_ZEPHYR_TARGET_JSON}" CACHE FILEPATH "SquidScript target metadata JSON")
if(SQUID_ZEPHYR_TARGET_JSON STREQUAL "")
  set(SQUID_ZEPHYR_TARGET_JSON "${CMAKE_CURRENT_LIST_DIR}/../../../../targets/esp32c3-super-mini.target.json")
endif()
set(SQUID_ZEPHYR_TARGET_OVERLAY "$ENV{SQUID_ZEPHYR_TARGET_OVERLAY}" CACHE FILEPATH "SquidScript Zephyr target overlay")
if(SQUID_ZEPHYR_TARGET_OVERLAY STREQUAL "")
  set(SQUID_ZEPHYR_TARGET_OVERLAY "${CMAKE_CURRENT_LIST_DIR}/../../boards/esp32c3_supermini.overlay")
endif()
set(SQUID_ZEPHYR_TARGET_DEFAULTS_H "${CMAKE_CURRENT_BINARY_DIR}/generated/squidscript_target_defaults.h")
execute_process(
  COMMAND "${Python3_EXECUTABLE}" "${CMAKE_CURRENT_LIST_DIR}/../../../../scripts/generate-zephyr-target-defaults.py" "${SQUID_ZEPHYR_TARGET_JSON}" "${SQUID_ZEPHYR_TARGET_DEFAULTS_H}" --zephyr-overlay "${SQUID_ZEPHYR_TARGET_OVERLAY}"
  RESULT_VARIABLE SQUID_ZEPHYR_TARGET_DEFAULTS_RESULT
)
if(NOT SQUID_ZEPHYR_TARGET_DEFAULTS_RESULT EQUAL 0)
  message(FATAL_ERROR "Failed to generate SquidScript Zephyr target defaults")
endif()

target_include_directories(app PRIVATE ../../src "${CMAKE_CURRENT_BINARY_DIR}/generated")
target_sources(app PRIVATE
  ../../src/app_store.c
  ../../src/ble_object_transfer.c
  src/main.c
)

squidscript_link_squidvm_ffi(app)
```

## Kconfig
```
menu "SquidScript BLE OTS parse test firmware"

config SQUIDSCRIPT_ZEPHYR_DIAGNOSTIC
	bool "Enable SquidScript diagnostic test paths"
	default y

config SQUIDSCRIPT_BLE_OTS_PARSE_TEST
	bool "Compile the SquidScript BLE OTS Object Name parser into the test image"
	default y
	help
	  Expose the Object Name parser in the native_sim test image so
	  unit tests can verify validation rules without a real Bluetooth
	  connection. The parser validates the extension-only Object Name
	  shape used by the custom BLE transfer service.

endmenu

source "Kconfig.zephyr"
```

## prj.conf
```kconfig
CONFIG_ZTEST=y
CONFIG_INIT_STACKS=y
CONFIG_THREAD_STACK_INFO=y
CONFIG_BT=y
```

## src/main.c
```c
#include <errno.h>
#include <string.h>

#include <zephyr/ztest.h>

#include "ble_object_transfer.h"

#define EXT_CAP 16

ZTEST_SUITE(ble_ots_parse, NULL, NULL, NULL, NULL, NULL);

ZTEST(ble_ots_parse, test_parses_extension_only_name)
{
	char ext[EXT_CAP] = {0};
	int result = sq_ble_ots_parse_object_name(".sqbc", ext, sizeof(ext));

	zassert_equal(result, 0, "expected 0, got %d", result);
	zassert_str_equal(ext, ".sqbc", "extension mismatch");
}

ZTEST(ble_ots_parse, test_rejects_routed_segments)
{
	char ext[EXT_CAP] = {0};
	int result = sq_ble_ots_parse_object_name("break-reminder/wallpaper/.sqbc", ext,
						  sizeof(ext));

	zassert_equal(result, BT_GATT_OTS_OACP_RES_INV_PARAM,
		      "expected INV_PARAM, got %d", result);
}

ZTEST(ble_ots_parse, test_rejects_empty_name)
{
	char ext[EXT_CAP] = {0};
	int result = sq_ble_ots_parse_object_name("", ext, sizeof(ext));

	zassert_equal(result, BT_GATT_OTS_OACP_RES_INV_PARAM,
		      "expected INV_PARAM, got %d", result);
}

ZTEST(ble_ots_parse, test_rejects_extension_not_starting_with_dot)
{
	char ext[EXT_CAP] = {0};
	int result = sq_ble_ots_parse_object_name("sqbc", ext, sizeof(ext));

	zassert_equal(result, BT_GATT_OTS_OACP_RES_INV_PARAM,
		      "expected INV_PARAM, got %d", result);
}

ZTEST(ble_ots_parse, test_rejects_extension_longer_than_buffer)
{
	char ext[4] = {0};
	int result = sq_ble_ots_parse_object_name(".thisisalongish", ext, sizeof(ext));

	zassert_equal(result, BT_GATT_OTS_OACP_RES_INV_PARAM,
		      "expected INV_PARAM, got %d", result);
}

ZTEST(ble_ots_parse, test_rejects_null_name)
{
	char ext[EXT_CAP] = {0};
	int result = sq_ble_ots_parse_object_name(NULL, ext, sizeof(ext));

	zassert_true(result < 0, "expected negative error from NULL name, got %d", result);
}
```
