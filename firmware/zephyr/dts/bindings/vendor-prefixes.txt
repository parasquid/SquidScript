## firmware/zephyr/tests/ble-app-install/testcase.yaml
```yaml
common:
  tags:
    - squidscript
    - ble-app-install
tests:
  squidscript.ble_app_install:
    platform_allow:
      - native_sim
      - native_sim/native/64
    integration_platforms:
      - native_sim/native/64
```

## firmware/zephyr/tests/ble-file-transfer-dispatch/testcase.yaml
```yaml
common:
  tags:
    - squidscript
    - ble-file-transfer-dispatch
tests:
  squidscript.ble_file_transfer_dispatch:
    platform_allow:
      - native_sim
      - native_sim/native/64
    integration_platforms:
      - native_sim/native/64
```

## firmware/zephyr/tests/ble-file-transfer-parse/Kconfig
```kconfig
menu "SquidScript BLE GATT parse test firmware"

config SQUIDSCRIPT_ZEPHYR_DIAGNOSTIC
	bool "Enable SquidScript diagnostic test paths"
	default y

config SQUIDSCRIPT_BLE_FILE_TRANSFER_PARSE_TEST
	bool "Compile the SquidScript BLE GATT File name parser into the test image"
	default y
	help
	  Expose the File name parser in the native_sim test image so
	  unit tests can verify validation rules without a real Bluetooth
	  connection. The parser validates the extension-only File name
	  shape used by the custom BLE transfer service.

endmenu

source "Kconfig.zephyr"
```

## firmware/zephyr/tests/ble-file-transfer-parse/testcase.yaml
```yaml
common:
  tags:
    - squidscript
    - ble-file-transfer-parse
tests:
  squidscript.ble_file_transfer_parse:
    platform_allow:
      - native_sim
      - native_sim/native/64
    integration_platforms:
      - native_sim/native/64
```

## firmware/zephyr/tests/ble-file-transfer-staging/testcase.yaml
```yaml
common:
  tags:
    - squidscript
    - ble-file-transfer-staging
tests:
  squidscript.ble_file_transfer_staging:
    platform_allow:
      - native_sim
      - native_sim/native/64
    integration_platforms:
      - native_sim/native/64
```

## firmware/zephyr/tests/ble-ots-dispatch/Kconfig
```kconfig
menu "SquidScript BLE OTS dispatch test firmware"

config SQUIDSCRIPT_ZEPHYR_DIAGNOSTIC
	bool "Enable SquidScript diagnostic test paths"
	default y

config SQUIDSCRIPT_BLE_OTS_DISPATCH_TEST
	bool "Compile the SquidScript BLE OTS pending-event handoff into the test image"
	default y
	help
	  Expose the producer (obj_write final → populate pending slot) and
	  consumer (drain pending slot → return app_id + event) sides of
	  the BLE Object Transfer dispatch in the native_sim test image.
	  The tests verify that a completed BLE transfer populates the
	  pending slot and that the drain call returns the expected
	  app_id and event name, and that the staging file is fs_unlink'd
	  after the drain. No real Bluetooth or VM is required.

endmenu

source "Kconfig.zephyr"
```

## firmware/zephyr/tests/ble-ots-parse/testcase.yaml
```yaml
common:
  tags:
    - squidscript
    - ble-ots-parse
tests:
  squidscript.ble_ots_parse:
    platform_allow:
      - native_sim
      - native_sim/native/64
    integration_platforms:
      - native_sim/native/64
```

## firmware/zephyr/tests/ble-ots-staging/testcase.yaml
```yaml
common:
  tags:
    - squidscript
    - ble-ots-staging
tests:
  squidscript.ble_ots_staging:
    platform_allow:
      - native_sim
      - native_sim/native/64
    integration_platforms:
      - native_sim/native/64
```

## firmware/zephyr/tests/ble-trigger-table/testcase.yaml
```yaml
common:
  tags:
    - squidscript
    - ble-trigger-table
tests:
  squidscript.ble_trigger_table:
    platform_allow:
      - native_sim
      - native_sim/native/64
    integration_platforms:
      - native_sim/native/64
```

## firmware/zephyr/tests/protocol/testcase.yaml
```yaml
common:
  tags:
    - squidscript
    - protocol
tests:
  squidscript.protocol.codec:
    platform_allow:
      - native_sim
      - native_sim/native/64
    integration_platforms:
      - native_sim/native/64
```

## firmware/zephyr/tests/sq-errno/testcase.yaml
```yaml
common:
  tags:
    - squidscript
    - sq-errno
tests:
  squidscript.sq_errno:
    platform_allow:
      - native_sim
      - native_sim/native/64
    integration_platforms:
      - native_sim/native/64
```

## tests/ble-ots-dispatch/testcase.yaml
```yaml
common:
  tags:
    - squidscript
    - ble-ots-dispatch
tests:
  squidscript.ble_ots_dispatch:
    platform_allow:
      - native_sim
      - native_sim/native/64
    integration_platforms:
      - native_sim/native/64
```
